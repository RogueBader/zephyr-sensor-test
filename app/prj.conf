## CMakeLists.txt
```
set(ZEPHYR_USE_RELATIVE_PATHS OFF)
add_compile_options(-fmacro-prefix-map=/=/)
cmake_minimum_required(VERSION 3.20.0)

find_package(Zephyr REQUIRED HINTS $ENV{ZEPHYR_BASE})

project(sensor_app)

target_sources(app PRIVATE
    src/main.c
    src/ringbuf.c
)
```

## prj.conf
```kconfig
CONFIG_SENSOR=y
CONFIG_SENSOR_XYZ=y
CONFIG_SENSOR_XYZ_RATE_HZ=100

CONFIG_LOG=y
CONFIG_LOG_DEFAULT_LEVEL=3

CONFIG_MAIN_STACK_SIZE=2048
```

## boards/native_posix.overlay
```dts
/ {
    aliases {
        accel0 = &xyz0;
    };
};

&{/} {
    xyz0: accel@0 {
        compatible = "sensor,xyz";
        label = "FAKE_XYZ";
        odr-hz = <100>;
    };
};
```

## src/main.c
```c
#include <zephyr/kernel.h>
#include <zephyr/logging/log.h>

#include "ringbuf.h"

LOG_MODULE_REGISTER(app);

#define SAMPLE_BATCH 20

static ringbuf_t *rb;

/* ---------- PRODUCER ---------- */

static void producer_work_handler(struct k_work *work);
K_WORK_DEFINE(producer_work, producer_work_handler);

static struct k_timer producer_timer;

static void producer_timer_handler(struct k_timer *timer)
{
    ARG_UNUSED(timer);
    k_work_submit(&producer_work);
}

static void producer_work_handler(struct k_work *work)
{
    ARG_UNUSED(work);

    struct accel_sample sample;

    int64_t t = k_uptime_get();

    sample.t_ms = t;
    sample.ax_ms2 = (float)(t % 100) / 50.0f;
    sample.ay_ms2 = (float)(t % 50) / 50.0f;
    sample.az_ms2 = 9.80f;

    if (rb_push(rb, &sample) != 0) {
        LOG_WRN("Ring buffer full");
    }
}

/* ---------- CONSUMER ---------- */

void consumer_thread(void)
{
    struct accel_sample buffer[SAMPLE_BATCH];

    while (1) {
        int count = rb_drain(rb, buffer, SAMPLE_BATCH);

        for (int i = 0; i < count; i++) {
            LOG_INF("{\"t\":%lld,\"x\":%.3f,\"y\":%.3f,\"z\":%.3f}",
                    buffer[i].t_ms,
                    (double)buffer[i].ax_ms2,
                    (double)buffer[i].ay_ms2,
                    (double)buffer[i].az_ms2);
        }

        k_sleep(K_MSEC(100));
    }
}

/* ---------- MAIN ---------- */

K_THREAD_DEFINE(consumer_tid, 1024, consumer_thread, NULL, NULL, NULL,
                5, 0, 0);

int main(void)
{
    LOG_INF("Starting simulated sensor app");

    rb = rb_create(64);
    if (!rb) {
        LOG_ERR("Ring buffer create failed");
        return 0;
    }

    k_timer_init(&producer_timer, producer_timer_handler, NULL);
    k_timer_start(&producer_timer, K_NO_WAIT, K_MSEC(100));

    return 0;
}
```

## src/ringbuf.c
```c
#include "ringbuf.h"
#include <stdlib.h>

ringbuf_t *rb_create(size_t capacity)
{
    if (capacity < 1) {
        return NULL;
    } 

    ringbuf_t *rb = malloc(sizeof(ringbuf_t));
    if (!rb){
        return NULL;
    }

    rb->buffer = malloc(sizeof(struct accel_sample) * capacity);
    if(!rb->buffer){
        free(rb);
        return NULL;
    }

    rb->capacity = capacity;
    rb->head = 0;
    rb->tail = 0;

    return rb;
}

void rb_destroy(ringbuf_t *rb)
{
    if (!rb) return;

    free(rb->buffer);
    free(rb);
}

static size_t next_index(size_t current, size_t capacity)
{
    return (current + 1) % capacity;
}

bool rb_push(ringbuf_t *rb, const struct accel_sample *s)
{
    size_t next_head = next_index(rb->head, rb->capacity);

    // Buffer full condition
    if (next_head == rb->tail){
        return false;
    }

    rb->buffer[rb->head] = *s;
    rb->head = next_head;

    return true;
}

bool rb_pop(ringbuf_t *rb, struct accel_sample *out)
{
    // Buffer empty condition
    if (rb->head == rb->tail){
        return false;
    }

    *out = rb->buffer[rb->tail];
    rb->tail = next_index(rb->tail, rb->capacity);

    return true;
} 

size_t rb_size(const ringbuf_t *rb)
{
    if (rb->head >= rb->tail){
        return (rb->head - rb->tail);
    }
    else {
        return (rb->capacity - rb->tail + rb->head);
    }
}

size_t rb_capacity(const ringbuf_t *rb)
{
    return rb->capacity;
} 

size_t rb_drain(ringbuf_t *rb, struct accel_sample *dst, size_t max)
{
    size_t count = 0;

    while (count < max && rb_pop(rb, &dst[count])) {
        count++;
    }

    return count;
}
```

## src/ringbuf.h
```c
#ifndef RINGBUF_H
#define RINGBUF_H

#include <stdint.h>
#include <stddef.h>
#include <stdbool.h>

#define RB_CAPACITY 256

struct accel_sample
{
    int64_t t_ms;
    float ax_ms2;
    float ay_ms2;
    float az_ms2;
};

typedef struct ringbuf
{
    struct accel_sample *buffer;
    size_t capacity;
    size_t head;
    size_t tail;
} ringbuf_t;

ringbuf_t *rb_create(size_t capacity);
void rb_destroy(ringbuf_t *rb);

bool rb_push(ringbuf_t *rb, const struct accel_sample *s);
bool rb_pop(ringbuf_t *rb, struct accel_sample *out);

size_t rb_size(const ringbuf_t *rb);
size_t rb_capacity(const ringbuf_t *rb);

size_t rb_drain(ringbuf_t *rb, struct accel_sample *dst, size_t max);

#endif
```
