## west.yml
```yaml
manifest:
  version: 0.13

  projects:
    - name: zephyr
      url: https://github.com/zephyrproject-rtos/zephyr
      revision: main

    - name: sensor-xyz
      path: modules/sensor_xyz
      url: https://github.com/RogueBader/sensor-xyz
      revision: main

  self:
    path: zephyr-sensor-test
```
